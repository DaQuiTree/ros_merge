## rockchip/rootfs/ros_packages/ros/ecl_core/ecl_threads/Config.in
```kconfig
config BR2_PACKAGE_ECL_THREADS
    bool "ecl_threads"
    help
      "ecl_threads" 
```

## rockchip/rootfs/ros_packages/ros/ecl_core/ecl_type_traits/Config.in
```kconfig
config BR2_PACKAGE_ECL_TYPE_TRAITS
    bool "ecl_type_traits"
    help
      "ecl_type_traits" 
```

## rockchip/rootfs/ros_packages/ros/ecl_core/ecl_utilities/Config.in
```kconfig
config BR2_PACKAGE_ECL_UTILITIES
    bool "ecl_utilities"
    help
      "ecl_utilities" 
```

## rockchip/rootfs/ros_packages/ros/ecl_lite/Config.in
```kconfig
menuconfig BR2_PACKAGE_ECL_LITE_SET
	bool "ecl_lite"
	depends on BR2_PACKAGE_HOST_CATKIN

if BR2_PACKAGE_ECL_LITE_SET
source "package/rockchip/ros/ecl_lite/ecl_config/Config.in"
source "package/rockchip/ros/ecl_lite/ecl_console/Config.in"
source "package/rockchip/ros/ecl_lite/ecl_converters_lite/Config.in"
source "package/rockchip/ros/ecl_lite/ecl_errors/Config.in"
source "package/rockchip/ros/ecl_lite/ecl_io/Config.in"
source "package/rockchip/ros/ecl_lite/ecl_sigslots_lite/Config.in"
source "package/rockchip/ros/ecl_lite/ecl_time_lite/Config.in"
endif
```

## rockchip/rootfs/ros_packages/ros/ecl_lite/ecl_config/Config.in
```kconfig
config BR2_PACKAGE_ECL_CONFIG
    bool "ecl_config"
    help
      "ecl_config" 
```

## rockchip/rootfs/ros_packages/ros/ecl_lite/ecl_console/Config.in
```kconfig
config BR2_PACKAGE_ECL_CONSOLE
    bool "ecl_console"
    help
      "ecl_console" 
```

## rockchip/rootfs/ros_packages/ros/ecl_lite/ecl_converters_lite/Config.in
```kconfig
config BR2_PACKAGE_ECL_CONVERTERS_LITE
    bool "ecl_converters_lite"
    help
      "ecl_converters_lite" 
```

## rockchip/rootfs/ros_packages/ros/ecl_lite/ecl_errors/Config.in
```kconfig
config BR2_PACKAGE_ECL_ERRORS
    bool "ecl_errors"
    help
      "ecl_errors" 
```

## rockchip/rootfs/ros_packages/ros/ecl_lite/ecl_sigslots_lite/Config.in
```kconfig
config BR2_PACKAGE_ECL_SIGSLOTS_LITE
    bool "ecl_sigslots_lite"
    help
      "ecl_sigslots_lite" 
```

## rockchip/rootfs/ros_packages/ros/ecl_lite/ecl_time_lite/Config.in
```kconfig
config BR2_PACKAGE_ECL_TIME_LITE
    bool "ecl_time_lite"
    help
      "ecl_time_lite" 
```

## rockchip/rootfs/ros_packages/ros/ecl_navigation/Config.in
```kconfig
menuconfig BR2_PACKAGE_ECL_NAVIGATION_SET
	bool "ecl_navigation"
	depends on BR2_PACKAGE_HOST_CATKIN

if BR2_PACKAGE_ECL_NAVIGATION_SET
source "package/rockchip/ros/ecl_navigation/ecl_mobile_robot/Config.in"
endif
```

## rockchip/rootfs/ros_packages/ros/ecl_navigation/ecl_mobile_robot/Config.in
```kconfig
config BR2_PACKAGE_ECL_MOBILE_ROBOT
    bool "ecl_mobile_robot"
    help
      "ecl_mobile_robot" 
```

## rockchip/rootfs/ros_packages/ros/ecl_tools/Config.in
```kconfig
menuconfig BR2_PACKAGE_ECL_TOOLS_SET
	bool "ecl_tools"
	depends on BR2_PACKAGE_HOST_CATKIN

if BR2_PACKAGE_ECL_TOOLS_SET
source "package/rockchip/ros/ecl_tools/ecl_build/Config.in"
source "package/rockchip/ros/ecl_tools/ecl_license/Config.in"
endif
```

## rockchip/rootfs/ros_packages/ros/ecl_tools/ecl_license/Config.in
```kconfig
config BR2_PACKAGE_ECL_LICENSE
    bool "ecl_license"
    help
      "ecl_license" 
```

## rockchip/rootfs/ros_packages/ros/perception_pcl/Config.in
```kconfig
menuconfig BR2_PACKAGE_PERCEPTION_PCL_SET
	bool "perception_pcl"
	depends on BR2_PACKAGE_HOST_CATKIN

if BR2_PACKAGE_PERCEPTION_PCL_SET
source "package/rockchip/ros/perception_pcl/pcl_msgs/Config.in"
source "package/rockchip/ros/perception_pcl/pcl_ros/Config.in"
source "package/rockchip/ros/perception_pcl/pcl_conversions/Config.in"
endif
```

## rockchip/rootfs/ros_packages/ros/perception_pcl/pcl_conversions/Config.in
```kconfig
config BR2_PACKAGE_PCL_CONVERSIONS_BUILD
    bool "pcl_conversions"
    help
      "pcl_conversions" 
```

## rockchip/rootfs/ros_packages/ros/perception_pcl/pcl_msgs/Config.in
```kconfig
config BR2_PACKAGE_PCL_MSGS_BUILD
    bool "pcl_msgs"
    help
      "pcl_msgs" 
```

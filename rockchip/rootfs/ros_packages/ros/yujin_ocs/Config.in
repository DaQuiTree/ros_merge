## rockchip/rootfs/ros_packages/ros/yujin_ocs/Config.in
```kconfig
menuconfig BR2_PACKAGE_YUJIN_OCS_SET
	bool "yujin_ocs"
	depends on BR2_PACKAGE_HOST_CATKIN

if BR2_PACKAGE_YUJIN_OCS_SET
source "package/rockchip/ros/yujin_ocs/yocs_ar_marker_tracking/Config.in"
source "package/rockchip/ros/yujin_ocs/yocs_ar_pair_approach/Config.in"
source "package/rockchip/ros/yujin_ocs/yocs_ar_pair_tracking/Config.in"
source "package/rockchip/ros/yujin_ocs/yocs_cmd_vel_mux/Config.in"
source "package/rockchip/ros/yujin_ocs/yocs_controllers/Config.in"
source "package/rockchip/ros/yujin_ocs/yocs_diff_drive_pose_controller/Config.in"
source "package/rockchip/ros/yujin_ocs/yocs_joyop/Config.in"
source "package/rockchip/ros/yujin_ocs/yocs_keyop/Config.in"
source "package/rockchip/ros/yujin_ocs/yocs_localization_manager/Config.in"
source "package/rockchip/ros/yujin_ocs/yocs_math_toolkit/Config.in"
source "package/rockchip/ros/yujin_ocs/yocs_navigator/Config.in"
source "package/rockchip/ros/yujin_ocs/yocs_navi_toolkit/Config.in"
source "package/rockchip/ros/yujin_ocs/yocs_rapps/Config.in"
source "package/rockchip/ros/yujin_ocs/yocs_safety_controller/Config.in"
source "package/rockchip/ros/yujin_ocs/yocs_velocity_smoother/Config.in"
source "package/rockchip/ros/yujin_ocs/yocs_virtual_sensor/Config.in"
source "package/rockchip/ros/yujin_ocs/yocs_waypoint_provider/Config.in"
source "package/rockchip/ros/yujin_ocs/yocs_waypoints_navi/Config.in"
endif
```

## rockchip/rootfs/ros_packages/ros/yujin_ocs/yocs_ar_marker_tracking/Config.in
```kconfig
config BR2_PACKAGE_YOCS_AR_MARKER_TRACKING
    bool "yocs_ar_marker_tracking"
    help
      "yocs_ar_marker_tracking" 
```

## rockchip/rootfs/ros_packages/ros/yujin_ocs/yocs_ar_pair_approach/Config.in
```kconfig
config BR2_PACKAGE_YOCS_AR_PAIR_APPROACH
    bool "yocs_ar_pair_approach"
    help
      "yocs_ar_pair_approach" 
```

## rockchip/rootfs/ros_packages/ros/yujin_ocs/yocs_ar_pair_tracking/Config.in
```kconfig
config BR2_PACKAGE_YOCS_AR_PAIR_TRACKING
    bool "yocs_ar_pair_tracking"
    help
      "yocs_ar_pair_tracking" 
```

## rockchip/rootfs/ros_packages/ros/yujin_ocs/yocs_cmd_vel_mux/Config.in
```kconfig
config BR2_PACKAGE_YOCS_CMD_VEL_MUX
    bool "yocs_cmd_vel_mux"
    help
      "yocs_cmd_vel_mux" 
```

## rockchip/rootfs/ros_packages/ros/yujin_ocs/yocs_controllers/Config.in
```kconfig
config BR2_PACKAGE_YOCS_CONTROLLERS
    bool "yocs_controllers"
    help
      "yocs_controllers" 
```

## rockchip/rootfs/ros_packages/ros/yujin_ocs/yocs_diff_drive_pose_controller/Config.in
```kconfig
config BR2_PACKAGE_YOCS_DIFF_DRIVE_POSE_CONTROLLER
    bool "yocs_diff_drive_pose_controller"
    help
      "yocs_diff_drive_pose_controller" 
```

## rockchip/rootfs/ros_packages/ros/yujin_ocs/yocs_joyop/Config.in
```kconfig
config BR2_PACKAGE_YOCS_JOYOP
    bool "yocs_joyop"
    help
      "yocs_joyop" 
```

## rockchip/rootfs/ros_packages/ros/yujin_ocs/yocs_keyop/Config.in
```kconfig
config BR2_PACKAGE_YOCS_KEYOP
    bool "yocs_keyop"
    help
      "yocs_keyop" 
```

## rockchip/rootfs/ros_packages/ros/yujin_ocs/yocs_localization_manager/Config.in
```kconfig
config BR2_PACKAGE_YOCS_LOCALIZATION_MANAGER
    bool "yocs_localization_manager"
    help
      "yocs_localization_manager" 
```

## rockchip/rootfs/ros_packages/ros/yujin_ocs/yocs_math_toolkit/Config.in
```kconfig
config BR2_PACKAGE_YOCS_MATH_TOOLKIT
    bool "yocs_math_toolkit"
    help
      "yocs_math_toolkit" 
```

## rockchip/rootfs/ros_packages/ros/yujin_ocs/yocs_navi_toolkit/Config.in
```kconfig
config BR2_PACKAGE_YOCS_NAVI_TOOLKIT
    bool "yocs_navi_toolkit"
    help
      "yocs_navi_toolkit" 
```

## rockchip/rootfs/ros_packages/ros/yujin_ocs/yocs_navigator/Config.in
```kconfig
config BR2_PACKAGE_YOCS_NAVIGATOR
    bool "yocs_navigator"
    help
      "yocs_navigator" 
```

## rockchip/rootfs/ros_packages/ros/yujin_ocs/yocs_rapps/Config.in
```kconfig
config BR2_PACKAGE_YOCS_RAPPS
    bool "yocs_rapps"
    help
      "yocs_rapps" 
```

## rockchip/rootfs/ros_packages/ros/yujin_ocs/yocs_safety_controller/Config.in
```kconfig
config BR2_PACKAGE_YOCS_SAFETY_CONTROLLER
    bool "yocs_safety_controller"
    help
      "yocs_safety_controller" 
```

## rockchip/rootfs/ros_packages/ros/yujin_ocs/yocs_velocity_smoother/Config.in
```kconfig
config BR2_PACKAGE_YOCS_VELOCITY_SMOOTHER
    bool "yocs_velocity_smoother"
    help
      "yocs_velocity_smoother" 
```

## rockchip/rootfs/ros_packages/ros/yujin_ocs/yocs_virtual_sensor/Config.in
```kconfig
config BR2_PACKAGE_YOCS_VIRTUAL_SENSOR
    bool "yocs_virtual_sensor"
    help
      "yocs_virtual_sensor" 
```

## rockchip/rootfs/ros_packages/ros/yujin_ocs/yocs_waypoint_provider/Config.in
```kconfig
config BR2_PACKAGE_YOCS_WAYPOINT_PROVIDER
    bool "yocs_waypoint_provider"
    help
      "yocs_waypoint_provider" 
```

## rockchip/rootfs/ros_packages/ros/yujin_ocs/yocs_waypoints_navi/Config.in
```kconfig
config BR2_PACKAGE_YOCS_WAYPOINTS_NAVI
    bool "yocs_waypoints_navi"
    help
      "yocs_waypoints_navi" 
```

## rockchip/rootfs/ros_packages/ros/yujin_ocs/yujin_ocs/Config.in
```kconfig
config BR2_PACKAGE_YUJIN_OCS_BUILD
    bool "yujin_ocs"
    help
      "yujin_ocs" 
```

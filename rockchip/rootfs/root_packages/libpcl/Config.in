## rockchip/rootfs/root_packages/libpcl/Config.in
```kconfig
config BR2_PACKAGE_LIBPCL
	bool "libpcl"
	help
	  The Point Cloud Library 
	  daqui modified
```

## rockchip/rootfs/root_packages/libvtk/Config.in
```kconfig
config BR2_PACKAGE_LIBVTK
	bool "libvtk"
	help
	  The Visualization Toolkit
	  daqui modified
```

## rockchip/rootfs/root_packages/xg-proj/Config.in
```kconfig
menuconfig BR2_PACKAGE_XG_PROJ
	bool "xg-proj packages"
	depends on BR2_PACKAGE_ROS_SUPPORT_SET
	depends on BR2_PACKAGE_ROS_KINETIC
	
if  BR2_PACKAGE_XG_PROJ
	source "package/xg-proj/robot_msgs/Config.in"
	source "package/xg-proj/topband_app/Config.in"
	source "package/xg-proj/kobuki/Config.in"
	source "package/xg-proj/xg_tasks/Config.in"
	source "package/xg-proj/baidu_speech/Config.in"
	source "package/xg-proj/ydlidar/Config.in"
	source "package/xg-proj/xg_gmapping/Config.in"
endif
```

## rockchip/rootfs/root_packages/xg-proj/baidu_speech/Config.in
```kconfig
config BR2_PACKAGE_BAIDU_SPEECH
    bool "baidu_speech"
    select BR2_PACKAGE_MESSAGE_GENERATION
    select BR2_PACKAGE_STD_MSGS
    select BR2_PACKAGE_ROSPY
    help
      "baidu_speech" 
```

## rockchip/rootfs/root_packages/xg-proj/kobuki/Config.in
```kconfig
config BR2_PACKAGE_KOBUKI
  bool "kobuki"
  depends on BR2_PACKAGE_HOST_CATKIN
  help
    "xiao gou kobuki"

if BR2_PACKAGE_KOBUKI
source "package/xg-proj/kobuki/kobuki_msgs/Config.in"
source "package/xg-proj/kobuki/kobuki_keyop/Config.in"
source "package/xg-proj/kobuki/kobuki_driver/Config.in"
source "package/xg-proj/kobuki/kobuki_ftdi/Config.in"
source "package/xg-proj/kobuki/kobuki_safety_controller/Config.in"
source "package/xg-proj/kobuki/kobuki_node/Config.in"
source "package/xg-proj/kobuki/robot_srv/Config.in"
endif
```

## rockchip/rootfs/root_packages/xg-proj/kobuki/kobuki_driver/Config.in
```kconfig
config BR2_PACKAGE_KOBUKI_DRIVER
    bool "kobuki_driver"
    select BR2_PACKAGE_ECL_BUILD
    select BR2_PACKAGE_ECL_MOBILE_ROBOT
    select BR2_PACKAGE_ECL_CONVERTERS
    select BR2_PACKAGE_ECL_DEVICES
    select BR2_PACKAGE_ECL_SIGSLOTS
    select BR2_PACKAGE_ECL_TIME
    select BR2_PACKAGE_ECL_COMMAND_LINE
    help
      "kobuki_driver" 
```

## rockchip/rootfs/root_packages/xg-proj/kobuki/kobuki_ftdi/Config.in
```kconfig
config BR2_PACKAGE_KOBUKI_FTDI
    bool "kobuki_ftdi"
    select BR2_PACKAGE_ECL_COMMAND_LINE
    select BR2_PACKAGE_LIBUSB
    select BR2_PACKAGE_LIBFTDI
    select BR2_PACKAGE_HOST_PKGCONF

    help
      "kobuki_ftdi" 
```

## rockchip/rootfs/root_packages/xg-proj/kobuki/kobuki_keyop/Config.in
```kconfig
config BR2_PACKAGE_KOBUKI_KEYOP
    bool "kobuki_keyop"
    select BR2_PACKAGE_STD_MSGS
    select BR2_PACKAGE_STD_SRVS
    select BR2_PACKAGE_ROSCPP
    select BR2_PACKAGE_GEOMETRY_MSGS
    select BR2_PACKAGE_ECL_EXCEPTIONS
    select BR2_PACKAGE_ECL_THREADS
    select BR2_PACKAGE_ECL_TIME
    select BR2_PACKAGE_KOBUKI_MSGS
    help
      "kobuki_keyop" 
```

## rockchip/rootfs/root_packages/xg-proj/kobuki/kobuki_msgs/Config.in
```kconfig
config BR2_PACKAGE_KOBUKI_MSGS
    bool "kobuki_msgs"
    select BR2_PACKAGE_STD_MSGS
    select BR2_PACKAGE_ACTIONLIB_MSGS
    select BR2_PACKAGE_MESSAGE_GENERATION
    select BR2_PACKAGE_GEOMETRY_MSGS
    help
      "kobuki_msgs" 
```

## rockchip/rootfs/root_packages/xg-proj/kobuki/kobuki_node/Config.in
```kconfig
config BR2_PACKAGE_KOBUKI_NODE
    bool "kobuki_node"
    select BR2_PACKAGE_ROSCPP
    select BR2_PACKAGE_GEOMETRY_MSGS
    select BR2_PACKAGE_NAV_MSGS
    select BR2_PACKAGE_STD_MSGS
    select BR2_PACKAGE_TF
    select BR2_PACKAGE_ANGLES
    select BR2_PACKAGE_DIAGNOSTIC_UPDATER_BUILD
    select BR2_PACKAGE_DIAGNOSTIC_MSGS
    select BR2_PACKAGE_NODELET
    select BR2_PACKAGE_PLUGINLIB
    select BR2_PACKAGE_ECL_EXCEPTIONS
    select BR2_PACKAGE_ECL_SIGSLOTS
    select BR2_PACKAGE_ECL_STREAMS
    select BR2_PACKAGE_ECL_THREADS
    select BR2_PACKAGE_ROBOT_SRV
    select BR2_PACKAGE_MSGS
    select BR2_PACKAGE_DRIVER
    select BR2_PACKAGE_FTDI
    select BR2_PACKAGE_KEYOP
    select BR2_PACKAGE_SAFE_CONTROLLER
    select BR2_PACKAGE_ROSPY
    select BR2_PACKAGE_TF_CONVERSIONS
    help
      "kobuki_node" 
```

## rockchip/rootfs/root_packages/xg-proj/kobuki/kobuki_safety_controller/Config.in
```kconfig
config BR2_PACKAGE_KOBUKI_SAFETY_CONTROLLER
    bool "kobuki_safety_controller"
    select BR2_PACKAGE_ROSCPP
    select BR2_PACKAGE_NODELET
    select BR2_PACKAGE_PLUGINLIB
    select BR2_PACKAGE_STD_MSGS
    select BR2_PACKAGE_GEOMETRY_MSGS
    select BR2_PACKAGE_KOBUKI_MSGS
    select BR2_PACKAGE_YOCS_CONTROLLERS
    select BR2_PACKAGE_ECL_THREADS
    help
      "kobuki_safety_controller" 
```

## rockchip/rootfs/root_packages/xg-proj/kobuki/robot_srv/Config.in
```kconfig
config BR2_PACKAGE_ROBOT_SRV
    bool "robot_srv"
    select BR2_PACKAGE_STD_MSGS
    select BR2_PACKAGE_ACTIONLIB_MSGS
    select BR2_PACKAGE_MESSAGE_GENERATION
    select BR2_PACKAGE_GEOMETRY_MSGS
    select BR2_PACKAGE_SENSOR_MSGS
    help
      "robot_srv" 
```

## rockchip/rootfs/root_packages/xg-proj/robot_msgs/Config.in
```kconfig
config BR2_PACKAGE_ROBOT_MSGS
    bool "robot_msgs"
    select BR2_PACKAGE_STD_MSGS
    select BR2_PACKAGE_ACTIONLIB_MSGS
    select BR2_PACKAGE_GEOMETRY_MSGS
    select BR2_PACKAGE_MESSAGE_GENERATION
    help
      "robot_msgs" 
```

## rockchip/rootfs/root_packages/xg-proj/topband_app/Config.in
```kconfig
config BR2_PACKAGE_TOPBAND_APP
    bool "topband_app"
    select BR2_PACKAGE_ROSCPP
    select BR2_PACKAGE_SENSOR_MSGS
    select BR2_PACKAGE_STD_MSGS
    select BR2_PACKAGE_ANGLES
    select BR2_PACKAGE_GEOMETRY_MSGS
    select BR2_PACKAGE_MESSAGE_GENERATION
    select BR2_PACKAGE_MESSAGE_RUNTIME
    help
      "topband_app" 
```

## rockchip/rootfs/root_packages/xg-proj/xg_gmapping/Config.in
```kconfig
config BR2_PACKAGE_XG_GMAPPING
  bool "xg_gmapping"
  depends on BR2_PACKAGE_HOST_CATKIN
  help
    "xiao gou gmapping"

if BR2_PACKAGE_XG_GMAPPING
source "package/xg-proj/xg_gmapping/amcl/Config.in"
source "package/xg-proj/xg_gmapping/msg_msg/Config.in"
source "package/xg-proj/xg_gmapping/openslam_gmapping/Config.in"
source "package/xg-proj/xg_gmapping/slam_gmapping/Config.in"
endif
```

## rockchip/rootfs/root_packages/xg-proj/xg_gmapping/amcl/Config.in
```kconfig
config BR2_PACKAGE_AMCL
    bool "AMCL"
    select BR2_PACKAGE_ROSBAG
    select BR2_PACKAGE_DYNAMIC_RECONFIGURE
    select BR2_PACKAGE_MESSAGE_FILTERS
    select BR2_PACKAGE_NAV_MSGS
    select BR2_PACKAGE_ROSCPP
    select BR2_PACKAGE_STD_SRVS
    select BR2_PACKAGE_TF
    help
      "amcl" 
```

## rockchip/rootfs/root_packages/xg-proj/xg_gmapping/msg_msg/Config.in
```kconfig
config BR2_PACKAGE_MSG_MSG
    bool "msg_msg"
    select BR2_PACKAGE_ROSCPP
    select BR2_PACKAGE_ROSPY
    select BR2_PACKAGE_MESSAGE_GENERATION
    select BR2_PACKAGE_MESSAGE_RUNTIME
    select BR2_PACKAGE_STD_MSGS
    help
      "msg_msg" 
```

## rockchip/rootfs/root_packages/xg-proj/xg_gmapping/openslam_gmapping/Config.in
```kconfig
config BR2_PACKAGE_OPENSLAM_GMAPPING
    bool "openslam_gmapping"
    help
      "openslam_gmapping" 
```

## rockchip/rootfs/root_packages/xg-proj/xg_gmapping/slam_gmapping/Config.in
```kconfig
config BR2_PACKAGE_SLAM_GMAPPING
    bool "slam_gmapping"
    select BR2_PACKAGE_ROSCPP
    select BR2_PACKAGE_TF
    select BR2_PACKAGE_ROSTEST
    select BR2_PACKAGE_NAV_MSGS
    select BR2_PACKAGE_NODELET
    select BR2_PACKAGE_AMCL
    select BR2_PACKAGE_OPENSLAM_GMAPPING
    help
      "slam_gmapping" 
```

## rockchip/rootfs/root_packages/xg-proj/xg_tasks/Config.in
```kconfig
config BR2_PACKAGE_XG_TASKS
  bool "xg_tasks"
  depends on BR2_PACKAGE_HOST_CATKIN
  help
    "xiao gou core jobs"

if BR2_PACKAGE_XG_TASKS
source "package/xg-proj/xg_tasks/nav_p2p_planner/Config.in"
source "package/xg-proj/xg_tasks/robot_machine/Config.in"
source "package/xg-proj/xg_tasks/global_clean_task/Config.in"
source "package/xg-proj/xg_tasks/robot_docking/Config.in"
source "package/xg-proj/xg_tasks/message_forward/Config.in"
endif
```

## rockchip/rootfs/root_packages/xg-proj/xg_tasks/global_clean_task/Config.in
```kconfig
config BR2_PACKAGE_GLOBAL_CLEAN_TASK
    bool "global_clean_task"
    depends on BR2_PACKAGE_NAV_P2P_PLANNER
    select BR2_PACKAGE_ACTIONLIB_MSGS
    select BR2_PACKAGE_CMAKE_MODULES
    select BR2_PACKAGE_DYNAMIC_RECONFIGURE
    select BR2_PACKAGE_GEOMETRY_MSGS
    select BR2_PACKAGE_MESSAGE_GENERATION
    select BR2_PACKAGE_NAV_MSGS
    select BR2_PACKAGE_PLUGINLIB
    select BR2_PACKAGE_ROSCPP
    select BR2_PACKAGE_ROSPY
    select BR2_PACKAGE_STD_SRVS
    select BR2_PACKAGE_TF
    select BR2_PACKAGE_ECL_EXCEPTIONS
    select BR2_PACKAGE_ECL_THREADS
    select BR2_PACKAGE_ECL_TIME
    help
      "global_clean_task" 
```

## rockchip/rootfs/root_packages/xg-proj/xg_tasks/message_forward/Config.in
```kconfig
config BR2_PACKAGE_MESSAGE_FORWARD
    bool "message_forward"
    select BR2_PACKAGE_GEOMETRY_MSGS
    select BR2_PACKAGE_NAV_MSGS
    select BR2_PACKAGE_ROBOT_MSGS
    select BR2_PACKAGE_ROSCPP
    select BR2_PACKAGE_SENSOR_MSGS
    select BR2_PACKAGE_STD_MSGS
    select BR2_PACKAGE_TF
    help
      "message_forward" 
```

## rockchip/rootfs/root_packages/xg-proj/xg_tasks/nav_p2p_planner/Config.in
```kconfig
config BR2_PACKAGE_NAV_P2P_PLANNER
    bool "nav_p2p_planner"
    select BR2_PACKAGE_ACTIONLIB_MSGS
    select BR2_PACKAGE_DYNAMIC_RECONFIGURE
    select BR2_PACKAGE_GEOMETRY_MSGS
    select BR2_PACKAGE_MESSAGE_GENERATION
    select BR2_PACKAGE_NAV_MSGS
    select BR2_PACKAGE_PLUGINLIB
    select BR2_PACKAGE_ROSCPP
    select BR2_PACKAGE_ROSPY
    select BR2_PACKAGE_TF
    select BR2_PACKAGE_SENSOR_MSGS
    select BR2_PACKAGE_ROBOT_MSGS
    select BR2_PACKAGE_ECL_EXCEPTIONS
    select BR2_PACKAGE_ECL_THREADS
    select BR2_PACKAGE_ECL_TIME
    select BR2_PACKAGE_ACTIONLIB
    help
      "nav_p2p_planner" 
```

## rockchip/rootfs/root_packages/xg-proj/xg_tasks/robot_docking/Config.in
```kconfig
config BR2_PACKAGE_ROBOT_DOCKING
    bool "robot_docking"
    select BR2_PACKAGE_ROSCPP
    select BR2_PACKAGE_STD_MSGS
    select BR2_PACKAGE_ROBOT_MSGS
    help
      "robot_docking" 
```

## rockchip/rootfs/root_packages/xg-proj/xg_tasks/robot_machine/Config.in
```kconfig
config BR2_PACKAGE_ROBOT_MACHINE
    bool "robot_machine"
    select BR2_PACKAGE_ROSCPP
    select BR2_PACKAGE_ROSPY
    select BR2_PACKAGE_STD_MSGS
    select BR2_PACKAGE_ROBOT_MSGS
    help
      "robot_machine" 
```

## rockchip/rootfs/root_packages/xg-proj/ydlidar/Config.in
```kconfig
config BR2_PACKAGE_YDLIDAR
    bool "ydlidar"
    select BR2_PACKAGE_ROSCONSOLE
    select BR2_PACKAGE_ROSCPP
    select BR2_PACKAGE_SENSOR_MSGS
    help
      "ydlidar" 
```

## rockchip/rootfs/ros_packages/ros/DKSample/Config.in
```kconfig
config BR2_PACKAGE_DKSAMPLE
	bool "daquis sample"
	select BR2_PACKAGE_ROSCPP
	select BR2_PACKAGE_ROSPY
	select BR2_PACKAGE_STD_MSGS
	select BR2_PACKAGE_GENMSG
	help
		a listener/speaker demo
```

## rockchip/rootfs/ros_packages/ros/diagnostics/Config.in
```kconfig
menuconfig BR2_PACKAGE_DIAGNOSTICS_SET
	bool "diagnostics"
	depends on BR2_PACKAGE_HOST_CATKIN

if BR2_PACKAGE_DIAGNOSTICS_SET
source "package/rockchip/ros/diagnostics/diagnostic_updater/Config.in"
source "package/rockchip/ros/diagnostics/diagnostic_aggregator/Config.in"
endif
```

## rockchip/rootfs/ros_packages/ros/diagnostics/diagnostic_aggregator/Config.in
```kconfig
config BR2_PACKAGE_DIAGNOSTIC_AGGREGATOR_BUILD
    bool "diagnostic_aggregator"
    help
      "diagnostic_aggregator" 
```

## rockchip/rootfs/ros_packages/ros/diagnostics/diagnostic_updater/Config.in
```kconfig
config BR2_PACKAGE_DIAGNOSTIC_UPDATER
    bool "diagnostic_updater"
    help
      "diagnostic_updater" 
```

## rockchip/rootfs/ros_packages/ros/ecl_core/Config.in
```kconfig
menuconfig BR2_PACKAGE_ECL_CORE_SET
	bool "ecl_core"
	depends on BR2_PACKAGE_HOST_CATKIN

if BR2_PACKAGE_ECL_CORE_SET
source "package/rockchip/ros/ecl_core/sophus/Config.in"
source "package/rockchip/ros/ecl_core/ecl_command_line/Config.in"
source "package/rockchip/ros/ecl_core/ecl_eigen/Config.in"
source "package/rockchip/ros/ecl_core/ecl_exceptions/Config.in"
source "package/rockchip/ros/ecl_core/ecl_mpl/Config.in"
source "package/rockchip/ros/ecl_core/ecl_time/Config.in"
source "package/rockchip/ros/ecl_core/ecl_ipc/Config.in"
source "package/rockchip/ros/ecl_core/ecl_type_traits/Config.in"
source "package/rockchip/ros/ecl_core/ecl_filesystem/Config.in"
source "package/rockchip/ros/ecl_core/ecl_math/Config.in"
source "package/rockchip/ros/ecl_core/ecl_concepts/Config.in"
source "package/rockchip/ros/ecl_core/ecl_converters/Config.in"
source "package/rockchip/ros/ecl_core/ecl_utilities/Config.in"
source "package/rockchip/ros/ecl_core/ecl_threads/Config.in"
source "package/rockchip/ros/ecl_core/ecl_formatters/Config.in"
source "package/rockchip/ros/ecl_core/ecl_containers/Config.in"
source "package/rockchip/ros/ecl_core/ecl_sigslots/Config.in"
source "package/rockchip/ros/ecl_core/ecl_linear_algebra/Config.in"
source "package/rockchip/ros/ecl_core/ecl_statistics/Config.in"
source "package/rockchip/ros/ecl_core/ecl_geometry/Config.in"
source "package/rockchip/ros/ecl_core/ecl_devices/Config.in"
source "package/rockchip/ros/ecl_core/ecl_streams/Config.in"
source "package/rockchip/ros/ecl_core/ecl_core_apps/Config.in"
source "package/rockchip/ros/ecl_core/ecl_core/Config.in"
endif
```

## rockchip/rootfs/ros_packages/ros/ecl_core/ecl_command_line/Config.in
```kconfig
config BR2_PACKAGE_ECL_COMMAND_LINE
    bool "ecl_command_line"
    help
      "ecl_command_line" 
```

## rockchip/rootfs/ros_packages/ros/ecl_core/ecl_concepts/Config.in
```kconfig
config BR2_PACKAGE_ECL_CONCEPTS
    bool "ecl_concepts"
    help
      "ecl_concepts" 
```

## rockchip/rootfs/ros_packages/ros/ecl_core/ecl_containers/Config.in
```kconfig
config BR2_PACKAGE_ECL_CONTAINERS
    bool "ecl_containers"
    help
      "ecl_containers" 
```

## rockchip/rootfs/ros_packages/ros/ecl_core/ecl_converters/Config.in
```kconfig
config BR2_PACKAGE_ECL_CONVERTERS
    bool "ecl_converters"
    help
      "ecl_converters" 
```

## rockchip/rootfs/ros_packages/ros/ecl_core/ecl_core_apps/Config.in
```kconfig
config BR2_PACKAGE_ECL_CORE_APPS
    bool "ecl_core_apps"
    help
      "ecl_core_apps" 
```

## rockchip/rootfs/ros_packages/ros/ecl_core/ecl_devices/Config.in
```kconfig
config BR2_PACKAGE_ECL_DEVICES
    bool "ecl_devices"
    help
      "ecl_devices" 
```

## rockchip/rootfs/ros_packages/ros/ecl_core/ecl_exceptions/Config.in
```kconfig
config BR2_PACKAGE_ECL_EXCEPTIONS
    bool "ecl_exceptions"
    help
      "ecl_exceptions" 
```

## rockchip/rootfs/ros_packages/ros/ecl_core/ecl_filesystem/Config.in
```kconfig
config BR2_PACKAGE_ECL_FILESYSTEM
    bool "ecl_filesystem"
    help
      "ecl_filesystem" 
```

## rockchip/rootfs/ros_packages/ros/ecl_core/ecl_formatters/Config.in
```kconfig
config BR2_PACKAGE_ECL_FORMATTERS
    bool "ecl_formatters"
    help
      "ecl_formatters" 
```

## rockchip/rootfs/ros_packages/ros/ecl_core/ecl_geometry/Config.in
```kconfig
config BR2_PACKAGE_ECL_GEOMETRY
    bool "ecl_geometry"
    help
      "ecl_geometry" 
```

## rockchip/rootfs/ros_packages/ros/ecl_core/ecl_linear_algebra/Config.in
```kconfig
config BR2_PACKAGE_ECL_LINEAR_ALGEBRA
    bool "ecl_linear_algebra"
    help
      "ecl_linear_algebra" 
```

## rockchip/rootfs/ros_packages/ros/ecl_core/ecl_sigslots/Config.in
```kconfig
config BR2_PACKAGE_ECL_SIGSLOTS
    bool "ecl_sigslots"
    help
      "ecl_sigslots" 
```

## rockchip/rootfs/ros_packages/ros/ecl_core/ecl_statistics/Config.in
```kconfig
config BR2_PACKAGE_ECL_STATISTICS
    bool "ecl_statistics"
    help
      "ecl_statistics" 
```

## rockchip/rootfs/ros_packages/ros/ecl_core/ecl_streams/Config.in
```kconfig
config BR2_PACKAGE_ECL_STREAMS
    bool "ecl_streams"
    help
      "ecl_streams" 
```
